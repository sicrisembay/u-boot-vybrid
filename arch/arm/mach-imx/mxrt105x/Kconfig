## arch/arm/mach-imx/mxrt105x/Kconfig
```kconfig
if ARCH_IMXRT105X

config SYS_SOC
	default "imxrt105x"

choice
	prompt "MXRT105X board select"
	optional

config TARGET_MXRT105X_EVK
        bool "Support mxrt105x EVK board"

config TARGET_MXRT105X_ZB
        bool "Support mxrt105x ZB"

endchoice

endif
```

## board/freescale/mxrt105x-zb/Kconfig
```kconfig
if TARGET_MXRT105X_ZB

config SYS_BOARD
	string
	default "mxrt105x-zb"

config SYS_VENDOR
	string
	default "freescale"

config SYS_SOC
	string
	default "imxrt105x"

config SYS_CONFIG_NAME
	string
	default "mxrt105x-zb"
	
menu "MXRT105X-ZB Board Setting"
	
choice
    prompt "MXRT105X ZB Revision"
    
config MXRT105X_ZB_VER3
    bool "Version 3"

config MXRT105X_ZB_VER4
    bool "Version 4"
    
endchoice

config MXRT105X_ZB_DISP_LT7381
    bool "LT7381 Display"
    default y
    depends on MXRT105X_ZB_VER3

config MXRT105X_ZB_DISP_FRIDA
    bool "Frida LCD"
    default y
    depends on MXRT105X_ZB_VER4
    
endmenu

endif
```
